## arch/arm/mach-bcm2708/Kconfig
```kconfig
menu "Broadcom BCM2708 Implementations"
	depends on ARCH_BCM2708

config MACH_BCM2708
	bool "Broadcom BCM2708 Development Platform"
	select NEED_MACH_MEMORY_H
	select NEED_MACH_IO_H
	select CPU_V6
	help
	  Include support for the Broadcom(R) BCM2708 platform.

config BCM2708_GPIO
	bool "BCM2708 gpio support"
	depends on MACH_BCM2708
	select ARCH_REQUIRE_GPIOLIB
        default y
	help
	  Include support for the Broadcom(R) BCM2708 gpio.

config BCM2708_GPIO_PPS
	bool "BCM2708 gpio PPS support"
	depends on BCM2708_GPIO
	select ARCH_REQUIRE_GPIOLIB
        default n
	help
	  Include support for Broadcom(R) BCM2708 gpio PPS.

config BCM2708_GPIO_PPS_PIN
	int "GPIO Pin to use for PPS"
	depends on BCM2708_GPIO_PPS
        default 24
	help
	   Defines the GPIO pin used for PPS

config BCM2708_VCMEM
	bool "Videocore Memory"
	depends on MACH_BCM2708
        default y
        help
          Helper for videocore memory access and total size allocation.	   

config BCM2708_NOL2CACHE
	bool "Videocore L2 cache disable"
	depends on MACH_BCM2708
        default n
        help
          Do not allow ARM to use GPU's L2 cache. Requires disable_l2cache in config.txt.

config BCM2708_DMAER
	tristate "BCM2708 DMA helper"
	depends on MACH_BCM2708
        default n
        help
          Enable DMA helper for accelerating X composition

endmenu
```
